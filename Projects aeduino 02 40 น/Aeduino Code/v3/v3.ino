#include <Wire.h>
#include <Adafruit_GFX.h>
#include <Adafruit_SH110X.h>
#include "RTClib.h"

// ===== OLED Setting =====
#define SCREEN_WIDTH 128
#define SCREEN_HEIGHT 64
#define OLED_RESET -1
Adafruit_SH1106G display(SCREEN_WIDTH, SCREEN_HEIGHT, &Wire, OLED_RESET);

// ===== RTC Setting =====
RTC_DS3231 rtc;
bool rtc_ok = false;

// ===== QR Code Data (จาก image2cpp) =====
const unsigned char qr1[] PROGMEM = {
 0xff, 0x00, 0x0f, 0xff, 0x03, 0xff, 0xff, 0xfe, 0x7e, 0x07, 0xc0, 0x00, 0xff, 0xf0, 0x00, 0xff, 
0xf0, 0x00, 0x00, 0xfe, 0x01, 0xff, 0xff, 0xfc, 0x3c, 0x07, 0x80, 0x00, 0x7f, 0x00, 0x00, 0x0f, 
0xc0, 0xff, 0xf0, 0x3f, 0xff, 0xfe, 0x3f, 0xfc, 0x3f, 0xc7, 0x80, 0x07, 0xfc, 0x0f, 0xff, 0x03, 
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0xff, 0x00, 0x07, 0xff, 0xf0, 0x3f, 0xe3, 0xfe, 0x7e, 0x00, 0x0f, 0xc0, 0xff, 0x81, 0xff, 0x81
};

void setup() {
  Serial.begin(115200);

  // สำหรับ ESP8266 D1 Mini: SDA = D2, SCL = D1
  Wire.begin(SDA, SCL);
  //Wire.begin(2, 3); 

  // เริ่มต้นจอ OLED (ที่อยู่ 0x3C)
  if (!display.begin(0x3c, true)) {
    Serial.println(F("OLED FAIL"));
    for (;;);
  }

  display.clearDisplay();
  display.setTextColor(SH110X_WHITE);

  // เริ่มต้น RTC
  if (rtc.begin()) {
    rtc_ok = true;
    Serial.println(F("RTC OK"));
    
    // ถ้าเวลาไม่ตรง ให้เอาคอมเมนต์ออกแล้วเบิร์น 1 รอบ จากนั้นคอมเมนต์กลับแล้วเบิร์นซ้ำ
    // rtc.adjust(DateTime(F(__DATE__), F(__TIME__)));
  } else {
    rtc_ok = false;
    Serial.println(F("RTC NOT FOUND"));
  }

  display.setTextSize(1);
  display.setCursor(35, 30);
  display.print("SYSTEM READY");
  display.display();
  delay(1500);
}

void loop() {
  bool isOpen = true; // Default เป็นเปิดหากหา RTC ไม่เจอ

  if (rtc_ok) {
    DateTime now = rtc.now();
    int hour = now.hour();
    int minute = now.minute();

    // เงื่อนไขเวลา: เปิด 06:00 - 07:45
    if (hour < 6) {
       isOpen = false;
      } else if (hour == 7 && minute > 45) {
      isOpen = false;
    } else if (hour > 7) {
      isOpen = false;
    } else {
      isOpen = true;
    }

    // Debug ผ่าน Serial Monitor
    Serial.printf("Current Time: %02d:%02d Status: %s\n", hour, minute, isOpen ? "OPEN" : "CLOSED");
  }

  display.clearDisplay();

  if (isOpen) {
    // แสดง QR Code
    display.drawBitmap(0, 0, qr1, 128, 64, SH110X_WHITE);
  } else {
    // แสดงข้อความเมื่อปิดระบบ
    display.setTextSize(2);
    display.setCursor(35, 25);
    display.print("CLOSE");
  }

  display.display();
  delay(1000);
}